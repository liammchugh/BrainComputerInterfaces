## CMakeLists.txt
```
cmake_minimum_required(VERSION 3.20.0)
find_package(Zephyr REQUIRED HINTS $ENV{ZEPHYR_BASE})
project(emg_headband)

target_sources(app PRIVATE
  src/main.cpp
  src/emg_adc.cpp
  src/ble_service.cpp
)
```

## prj.conf
```kconfig
# BLE
CONFIG_BT                               = y
CONFIG_BT_PERIPHERAL                    = y
CONFIG_BT_DEVICE_NAME                   = "EMG_HEADBAND"
CONFIG_BT_DEVICE_APPEARANCE             = 833          # Generic Sensor
CONFIG_BT_CTLR_DATA_LENGTH_MAX          = 251
CONFIG_BT_BUF_ACL_TX_SIZE               = 251
CONFIG_BT_BUF_ACL_RX_SIZE               = 251
CONFIG_BT_MAX_CONN                      = 1
CONFIG_BT_PERIPHERAL_PREF_MIN_INT       = 6            # 7.5 ms
CONFIG_BT_PERIPHERAL_PREF_MAX_INT       = 6
CONFIG_BT_GATT_DYNAMIC_DB               = y

# ADC + DMA
CONFIG_ADC                              = y
CONFIG_DMA                              = y
CONFIG_NRFX_TIMER                       = y            # used for 1 kHz trigger
CONFIG_CMSIS_DSP                        = y

# RTOS & debug
CONFIG_MAIN_STACK_SIZE                  = 2048
CONFIG_SYSTEM_WORKQUEUE_STACK_SIZE      = 2048
CONFIG_LOG                              = y
CONFIG_LOG_MODE_DEFERRED                = y
CONFIG_ASSERT                           = y
```

## src/main.cpp
```c
#include "emg_adc.hpp"
extern void ble_service_init();

int main()
{
    k_fifo_init(&adc_fifo);
    emg_adc_init();
    ble_service_init();
    return 0;
}
```

## src/ble_service.cpp
```c
#include "emg_adc.hpp"
#include <zephyr/bluetooth/bluetooth.h>
#include <zephyr/bluetooth/gatt.h>
#include <zephyr/logging/log.h>
LOG_MODULE_REGISTER(ble_svc, LOG_LEVEL_INF);

/* 128-bit base UUID: 3F5Bxxxx-D946-4844-B1CE-B29134DDEAF5 */
#define BT_UUID_EMG_SERVICE  BT_UUID_128_ENCODE(0x3F5B0001,0xD946,0x4844,0xB1CE,0xB29134DDEAF5)
#define BT_UUID_EMG_DATA_CH  BT_UUID_128_ENCODE(0x3F5B0002,0xD946,0x4844,0xB1CE,0xB29134DDEAF5)

static struct bt_conn *current_conn;
static uint8_t notify_enabled;

static ssize_t ccc_cfg(const bt_gatt_attr*, uint16_t, uint16_t flags, const void *value, uint16_t len)
{
    notify_enabled = bt_gatt_is_subscribed(current_conn, BT_GATT_CCC(value), BT_GATT_CCC_NOTIFY);
    return len;
}

BT_GATT_SERVICE_DEFINE(emg_svc,
    BT_GATT_PRIMARY_SERVICE(BT_UUID_EMG_SERVICE),
    BT_GATT_CHARACTERISTIC(BT_UUID_EMG_DATA_CH,
        BT_GATT_CHRC_NOTIFY,
        BT_GATT_PERM_NONE, NULL, NULL, NULL),
    BT_GATT_CCC(ccc_cfg, BT_GATT_PERM_READ | BT_GATT_PERM_WRITE),
);

static void connected(struct bt_conn *conn, uint8_t err)
{
    if (!err) current_conn = bt_conn_ref(conn);
}
static void disconnected(struct bt_conn *conn, uint8_t) { bt_conn_unref(current_conn); }

BT_CONN_CB_DEFINE(conn_cb) = {
    .connected = connected,
    .disconnected = disconnected,
};

void ble_service_init()
{
    bt_enable(nullptr);
    bt_le_adv_start(BT_LE_ADV_CONN_NAME, NULL, 0, NULL, 0);
    LOG_INF("BLE advertising");
}

/* Worker thread: pop frames and notify */
void ble_tx_thread()
{
    emg_frame_t *f;
    while (true) {
        f = (emg_frame_t*)k_fifo_get(&adc_fifo, K_FOREVER);
        if (notify_enabled && current_conn) {
            bt_gatt_notify(current_conn, &emg_svc.attrs[1],
                           f->sample, sizeof(f->sample));
        }
        k_free(f);
    }
}

K_THREAD_DEFINE(ble_tx_id, 1024, ble_tx_thread, NULL, NULL, NULL,
                5, 0, 0);
```

## src/emg_adc.cpp
```c
#include "emg_adc.hpp"
#include <zephyr/device.h>
#include <zephyr/drivers/clock_control.h>
#include <zephyr/drivers/timer/nrf_rtc_timer.h>   // STM32 uses generic timer; choose TIM2
#include <zephyr/logging/log.h>
LOG_MODULE_REGISTER(emg_adc, LOG_LEVEL_INF);

static const struct device *adc = DEVICE_DT_GET_ONE(st_stm32_adc);
static int16_t dma_buf[2][EMG_CH];               // ping-pong
static uint8_t buf_idx;

static void dma_callback(const struct device*, void*, uint32_t, int)
{
    auto *frame = (emg_frame_t*)k_malloc(sizeof(emg_frame_t));
    frame->tick_us = k_cycle_get_32() / (CONFIG_SYS_CLOCK_HW_CYCLES_PER_SEC / 1000000);
    memcpy(frame->sample, dma_buf[buf_idx], sizeof(frame->sample));
    k_fifo_put(&adc_fifo, frame);
    buf_idx ^= 1;
}

void emg_adc_init()
{
    /* Timer trigger @1 kHz */
    const struct device *tim = DEVICE_DT_GET(DT_ALIAS(timer2));
    timer_configure(tim, 1000);  // helper util you’d write for TIM & Zephyr counter API

    /* ADC sequence */
    struct adc_channel_cfg ch = {
        .gain             = ADC_GAIN_1,
        .reference        = ADC_REF_INTERNAL,
        .acquisition_time = ADC_ACQ_TIME_DEFAULT,
    };
    for (uint8_t i = 0; i < EMG_CH; ++i) {
        ch.channel_id = i;
        adc_channel_setup(adc, &ch);
    }

    struct adc_sequence seq = {
        .channels    = BIT_MASK(EMG_CH),
        .buffer      = dma_buf[0],
        .buffer_size = sizeof(dma_buf[0]),
        .resolution  = 12,
        .oversampling = 4,                 // optional
        .calibrate = true,
    };

    adc_dma_start(adc, &seq, dma_callback);       // Zephyr v4.2 helper
    LOG_INF("ADC started @1 kHz x %d ch", EMG_CH);
}
```

## src/emg_adc.hpp
```c
#pragma once
#include <zephyr/kernel.h>
#include <zephyr/drivers/adc.h>

constexpr uint8_t  EMG_CH   = 5;          // 3-5 sensors; pick 5 max
constexpr uint16_t EMG_SPS  = 1000;       // target sample rate

struct emg_frame_t {
    uint32_t tick_us;                     // µs timestamp
    int16_t  sample[EMG_CH];
};

// double-buffer for DMA ping-pong
inline k_fifo adc_fifo;
void emg_adc_init();
```
